## arch/arm64/configs/exynos9810-star2lte_defconfig
```kconfig
CONFIG_CAMERA_CIS_3M3_OBJ=y
# CONFIG_OIS_USE_RUMBA_S4 is not set
# CONFIG_CAMERA_STAR is not set
CONFIG_CAMERA_STAR2=y
CONFIG_OIS_USE_RUMBA_S6=y
```

## arch/arm64/configs/exynos9810-starlte_defconfig
```kconfig
# CONFIG_CAMERA_CIS_3M3_OBJ is not set
CONFIG_OIS_USE_RUMBA_S4=y
CONFIG_CAMERA_STAR=y
# CONFIG_CAMERA_STAR2 is not set
# CONFIG_OIS_USE_RUMBA_S6 is not set
```

## arch/arm64/configs/exynos9810-starxlte_defconfig
```kconfig
CONFIG_INPUT_TOUCHSCREEN_TCLM=y
# CONFIG_INPUT_TOUCHSCREEN_TCLMV2 is not set
CONFIG_TOUCHSCREEN_SEC_TS=y
# CONFIG_TOUCHSCREEN_SEC_TS_Y771 is not set
# CONFIG_INPUT_WACOM is not set
# CONFIG_EPEN_WACOM_W9018 is not set
# CONFIG_WIRELESS_FIRMWARE_65 is not set
# CONFIG_SENSORS_SSP_AK09918 is not set
# CONFIG_SENSORS_SSP_LIGHT_MAX_GAIN_2BYTE is not set
CONFIG_SENSORS_SSP_STAR=y
# CONFIG_SENSORS_SSP_CROWN is not set
# CONFIG_SELF_MOVE_3PX is not set
# CONFIG_CAMERA_CROWN is not set
```

## drivers/fingerprint/Kconfig
```kconfig
#
# Sensor  drivers configuration
#
menuconfig SENSORS_FINGERPRINT
	bool "Finger Print Sensor devices"
	help
	  Say Y here, and a list of sensors drivers will be displayed.
	  Everything that didn't fit into the other categories is here. This option
	  doesn't affect the kernel.
	  If unsure, say Y.

if SENSORS_FINGERPRINT
config SENSORS_ET5XX
	tristate "ET5XX fingerprint sensor support"
	default n
	help
	  If you say yes here you get support for Egistec's
	  fingerprint sensor ET5XX.
config SENSORS_ET7XX
	tristate "ET7XX fingerprint sensor support"
	default n
	help
	  If you say yes here you get support for Egistec's
	  fingerprint sensor ET7XX.
config SENSORS_VFS7XXX
	tristate "VFS7XXX fingerprint sensor support"
	default n
	help
	  Fingerprint sensor driver.
	  If you say yes here you get support for viper2 sensor.
	  Viper2 is the touch type fingerprint sensor.
	  Viper2 82E5 module can support WOG mode.

config SENSORS_VFS8XXX
	tristate "VFS8XXX fingerprint sensor support"
	default n
	help
	  Fingerprint sensor driver.
	  If you say yes here you get support for Namsan sensor.
	  Namsan is the touch type fingerprint sensor.
	  Namsan module can support WOF mode.
endif
```

## drivers/motor/Kconfig
```kconfig
config MOTOR_DRV_MAX77865
	tristate "Maxim MAX77854 motor"
	default n
	depends on MFD_MAX77865
	help
	  If you say yes here you will get support for the
	  motor of Maxim MAX77865 PMIC.
	  To enable this driver, MFD_MAX77865 should be enabled and
	  MFD_MAX77865 calls this driver.

config MOTOR_DRV_MAX77705
	tristate "Maxim MAX77705 motor"
	default n
	depends on MFD_MAX77705
	help
	  If you say yes here you will get support for the
	  motor of Maxim MAX77705 PMIC.
	  To enable this driver, MFD_MAX77705 should be enabled and
	  MFD_MAX77705 calls this driver.

config SEC_HAPTIC
	tristate "sec haptic"
	default n
	depends on SEC_SYSFS
	help
	  If you say yes here you will get support for the
	  sec haptic driver.
	  To enable this driver, SEC_SYSFS should be enabled and
	  motor driver calls this driver.

config SEC_HAPTIC_TEST
	bool "KUnit test for sec_haptic_test"
	default n
	help
	  If you want to enable this, please say yes in kunitconfig.
	  To run test cases for SEC_HAPTIC,
	  SEC_HAPTIC_TEST should be enabled.
```
